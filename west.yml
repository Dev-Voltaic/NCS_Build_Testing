## west.yml
```yaml
# Import requirements for nRF9160 Feather Examples and Drivers
manifest:
  remotes:
    - name: nrfconnect
      url-base: https://github.com/nrfconnect
  projects:
    - name: nrf
      repo-path: sdk-nrf
      remote: nrfconnect
      revision: v2.3.0
      import: 
        name-blocklist:
          - matter
          - nrf-802154
          - cjson
          - openthread
          - cmock
          - unity
          - cddl-gen
          - homekit
          - loramac-node
          - lz4
          - lvgl
          - mipi-sys-t
    # Pyrinas backend
    - name: pyrinas
      url: https://github.com/pyrinas-iot/pyrinas-zephyr
      revision: v1.7.x
      path: pyrinas
      import: true
  self:
    # This repository should be cloned to nrf9160-feather
    path: nfed
```
